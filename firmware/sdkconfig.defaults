## firmware/sdkconfig.defaults
```kconfig
CONFIG_HTTPD_MAX_REQ_HDR_LEN=1024
CONFIG_RTC_CLK_SRC_EXT_CRYS=y
CONFIG_ESP_SYSTEM_RTC_EXT_XTAL_BOOTSTRAP_CYCLES=10
CONFIG_ESP_TIMER_SHOW_EXPERIMENTAL=y
CONFIG_NEWLIB_TIME_SYSCALL_USE_RTC=y
CONFIG_ULP_COPROC_ENABLED=y
CONFIG_ULP_COPROC_RESERVE_MEM=16000
CONFIG_WIFI_MANAGER_MAX_RETRY_START_AP=9999
CONFIG_DEFAULT_AP_PASSWORD=""
```
